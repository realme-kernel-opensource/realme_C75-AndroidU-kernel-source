## drivers/misc/mediatek/sensors-1.0/Kconfig
```kconfig
config MTK_SENSOR_SUPPORT
	tristate "MTK_SENSOR_SUPPORT"
	help
		Sensor config for sensor feature in project.
		Please say y here if you want to support sensors
		with mediatek sesnor architecture.
		If unsure, say N.

source "drivers/misc/mediatek/sensors-1.0/accelerometer/Kconfig"
source "drivers/misc/mediatek/sensors-1.0/alsps/Kconfig"
source "drivers/misc/mediatek/sensors-1.0/gyroscope/Kconfig"
source "drivers/misc/mediatek/sensors-1.0/magnetometer/Kconfig"
source "drivers/misc/mediatek/sensors-1.0/hwmon/Kconfig"
source "drivers/misc/mediatek/sensors-1.0/barometer/Kconfig"
source "drivers/misc/mediatek/sensors-1.0/step_counter/Kconfig"
source "drivers/misc/mediatek/sensors-1.0/situation/Kconfig"
source "drivers/misc/mediatek/sensors-1.0/sensorHub/Kconfig"
source "drivers/misc/mediatek/sensors-1.0/sensorfusion/Kconfig"
source "drivers/misc/mediatek/sensors-1.0/oplus_sensor_devinfo/Kconfig"
source "drivers/misc/mediatek/sensors-1.0/oplus_virtual_sensor/Kconfig"
source "drivers/misc/mediatek/sensors-1.0/oplus_virtual_sensor/sensors/camera_protecthub/Kconfig"
source "drivers/misc/mediatek/sensors-1.0/oplus_virtual_sensor/sensors/free_fallhub/Kconfig"
source "drivers/misc/mediatek/sensors-1.0/oplus_virtual_sensor/sensors/pickup_detecthub/Kconfig"
source "drivers/misc/mediatek/sensors-1.0/oplus_virtual_sensor/sensors/fp_displayhub/Kconfig"
source "drivers/misc/mediatek/sensors-1.0/oplus_virtual_sensor/sensors/lux_aodhub/Kconfig"
source "drivers/misc/mediatek/sensors-1.0/oplus_virtual_sensor/sensors/pedo_minutehub/Kconfig"
source "drivers/misc/mediatek/sensors-1.0/oplus_virtual_sensor/sensors/oplus_activity_recognitionhub/Kconfig"
source "drivers/misc/mediatek/sensors-1.0/oplus_virtual_sensor/sensors/tp_gesturehub/Kconfig"
source "drivers/misc/mediatek/sensors-1.0/oplus_virtual_sensor/sensors/elevator_detecthub/Kconfig"
source "drivers/misc/mediatek/sensors-1.0/rear_als/Kconfig"
source "drivers/misc/mediatek/sensors-1.0/oplus_virtual_sensor/sensors/back_tap_detecthub/Kconfig"
source "drivers/misc/mediatek/sensors-1.0/rear_flicker/Kconfig"
source "drivers/misc/mediatek/sensors-1.0/oplus_virtual_sensor/sensors/palm_detecthub/Kconfig"
```
