## arch/arm64/configs/k69v1_64_k510_defconfig
```kconfig
CONFIG_BUILD_CONFIG_FILE="build.config.mtk.aarch64"
CONFIG_ABI_MONITOR=y
CONFIG_ARCH_MEDIATEK=y
CONFIG_MTK_AEE_FEATURE=m
CONFIG_MTK_AEE_AED=m
CONFIG_MTK_AEE_HANGDET=m
CONFIG_MTK_AEE_IPANIC=m
CONFIG_MTK_DRAM_LOG_STORE=m
CONFIG_MTK_DRAM_LOG_STORE_ADDR=0x10E700
CONFIG_MTK_DRAM_LOG_STORE_SIZE=0x100
CONFIG_MTK_ATF_LOGGER=m
CONFIG_MTK_HANG_DETECT=m
CONFIG_MTK_HANG_DETECT_DB=y
CONFIG_BATTERY_MT6358=m
CONFIG_MFD_MT6370=m
CONFIG_MT6370_DBG=m
CONFIG_BACKLIGHT_MT6370=m
CONFIG_MTK_SUBPMIC_MISC=m
CONFIG_MTK_SPM=m
CONFIG_MTK_POWER_GS_LEGACY=m
CONFIG_MTK_UNIFIED_POWER_COMMON=m
CONFIG_MTK_PLAT_POWER_MT6768=m
CONFIG_MFD_MT6397=m
CONFIG_MTK_PMIC_WRAP=m
CONFIG_REGULATOR_MT6358=m
CONFIG_MEDIATEK_MT635X_AUXADC=m
CONFIG_MEDIATEK_CPU_DVFS=m
CONFIG_MEMORY=y
CONFIG_HAVE_MTK_MC=y
CONFIG_MTK_EMI_LEGACY=m
CONFIG_MTK_EMI_BWL_VERSION=2
CONFIG_MTK_DRAMC=m
CONFIG_MMSTAT_TRACER=m
CONFIG_REGULATOR_MT6370=m
CONFIG_COMMON_CLK_MT6768=m
CONFIG_COMMON_CLK_PG_LEGACY=m
CONFIG_MTK_SCPSYS=m
CONFIG_MTK_IPI=m
CONFIG_MTK_MBOX=m
CONFIG_RPMSG_MTK=m
CONFIG_MTK_TINYSYS_SSPM_SUPPORT=m
CONFIG_MTK_TINYSYS_SSPM_V1=y
CONFIG_MTK_CLKBUF=m
CONFIG_MTK_CLKBUF_V1=y
CONFIG_MEDIATEK_DCM_COMMON=y
CONFIG_MEDIATEK_DCM_MT6768=m
CONFIG_MTK_UNIFIED_POWER=m
CONFIG_MTK_STATIC_POWER_LEGACY=m
CONFIG_MTK_PTPOD_LEGACY=m
CONFIG_MEDIATEK_CPUIDLE=m
CONFIG_MTK_CPUHOTPLUG=m
CONFIG_MEDIATEK_MCDI=m
CONFIG_INTERCONNECT_MTK=y
CONFIG_INTERCONNECT_MTK_MMQOS_MT6768=m
CONFIG_MTK_IOMMU=m
CONFIG_DMABUF_HEAPS_MTK_MM=m
CONFIG_DMABUF_HEAPS_SYSTEM=m
CONFIG_DMABUF_HEAPS_DEBUG=m
CONFIG_CHARGER_MT6370=m
CONFIG_MTK_CHARGER=m
CONFIG_MTK_CHARGER_TYPE_DETECT=m
CONFIG_MTK_PUMP_EXPRESS_PLUS_20_SUPPORT=m
CONFIG_MTK_PUMP_EXPRESS_40_SUPPORT=m
CONFIG_MTK_PUMP_EXPRESS_50_SUPPORT=m
CONFIG_MTK_PUMP_EXPRESS_PLUS_SUPPORT=m
CONFIG_MTK_BATTERY_OC_POWER_THROTTLING=m
CONFIG_MTK_BATTERY_PERCENT_THROTTLING=m
CONFIG_MTK_DYNAMIC_LOADING_POWER_THROTTLING=m
CONFIG_MTK_LOW_BATTERY_POWER_THROTTLING=m
CONFIG_MTK_CPU_POWER_THROTTLING=m
CONFIG_PMIC_LBAT_SERVICE=m
CONFIG_MTK_IOMMU_MISC=m
CONFIG_MTK_IOMMU_MISC_DBG=m
CONFIG_MTK_IOMMU_MISC_TEST=m
CONFIG_MTK_IOMMU_MISC_SECURE=m
CONFIG_DRM_MEDIATEK=m
CONFIG_DRM_MEDIATEK_V2=y
CONFIG_SND_SOC_MT6660=m
CONFIG_SND_SOC_MT6768=m
CONFIG_SND_SOC_MT6768_MT6358=m
CONFIG_SND_SOC_MTK_BTCVSD=m
CONFIG_SERIAL_8250_MT6577=m
CONFIG_PWM_MTK_DISP=m
CONFIG_LEDS_MTK=m
CONFIG_LEDS_MTK_DISP=m
CONFIG_LEDS_MTK_PWM=m
CONFIG_LEDS_MT6370_FLASH=m
CONFIG_MTK_UART_APDMA=m
CONFIG_MTK_CQDMA=m
CONFIG_TOUCHSCREEN_MTK_TOUCH="GT9886 GT1151"
CONFIG_MTPROF=m
CONFIG_USB_POWER_DELIVERY=m
CONFIG_TCPC_CLASS=m
CONFIG_TCPC_RT1711H=m
CONFIG_OPLUS_PD_EXT_SUPPORT=y
CONFIG_LEDS_REGULATOR_VIBRATOR=m
CONFIG_MTK_SDA=y
CONFIG_MTK_CACHE_PARITY_CHECK=m
CONFIG_MTK_IRQ_DBG_LEGACY=m
CONFIG_MEDIATEK_WATCHDOG=m
CONFIG_RTC_DRV_MT6397=m
CONFIG_MTK_SECURITY_SW_SUPPORT=m
CONFIG_MMSTAT_TRACER=m
CONFIG_MTK_CM_MGR=m
CONFIG_MTK_CM_MGR_MT6768=m
CONFIG_MT635X_EFUSE=m
CONFIG_MTK_BTIF=m
CONFIG_MTK_COMBO=m
CONFIG_MTK_COMBO_CHIP_CONSYS_6768=y
CONFIG_MTK_COMBO_GPS=m
CONFIG_MTK_GPS_SUPPORT=y
CONFIG_MTK_GPS_EMI=m
CONFIG_MTK_FMRADIO=m
CONFIG_MTK_FM_CHIP="MT6631_FM"
CONFIG_MTK_CONNSYS_DEDICATED_LOG_PATH=y
# CONFIG_MTK_CONN_LTE_IDC_SUPPORT is not set
# CONFIG_HW_RANDOM_MTK is not set
# CONFIG_MST_IRQ is not set
# CONFIG_PINCTRL_MT2712 is not set
# CONFIG_PINCTRL_MT6797 is not set
# CONFIG_PINCTRL_MT6779 is not set
# CONFIG_PINCTRL_MT7622 is not set
# CONFIG_PINCTRL_MT8167 is not set
# CONFIG_PINCTRL_MT8173 is not set
# CONFIG_PINCTRL_MT8183 is not set
# CONFIG_PINCTRL_MT8192 is not set
# CONFIG_PINCTRL_MT8516 is not set
# CONFIG_PINCTRL_MT6397 is not set
CONFIG_PINCTRL_MT6768=m
CONFIG_I2C_MT65XX=m
CONFIG_EINT_MTK=m
CONFIG_MTK_MMSYS=m
CONFIG_MMC_MTK=m
CONFIG_MMC_MTK_PRO=m
CONFIG_MMC_CQHCI=m
CONFIG_MMC_AUTOK=m
CONFIG_MMC_DEBUG=m
CONFIG_UFSFEATURE=y
CONFIG_SCSI_UFS_MEDIATEK=m
CONFIG_SCSI_UFS_MEDIATEK_DBG=m
CONFIG_MTK_BLOCK_IO_TRACER=m
CONFIG_MTK_DVFSRC_HELPER=m
CONFIG_MTK_DVFSRC_MET_MT6768=m
CONFIG_INTERCONNECT_MTK_EMI=m
CONFIG_REGULATOR_MTK_DVFSRC=m
CONFIG_MTK_DVFSRC=m
CONFIG_MTK_DVFSRC_DEVFREQ=m
CONFIG_MTK_CMDQ_MBOX_EXT=m
CONFIG_MTK_MDP=m
CONFIG_MTK_MDP_MTEE_SUPPORT=m
CONFIG_MTK_MDPM_LEGACY_V1=m
CONFIG_MTK_PBM_LEGACY=m
CONFIG_MMPROFILE=m
CONFIG_TEE=m
CONFIG_TEE_PERF_SUPPORT=m
CONFIG_TRUSTONIC_TEE_SUPPORT=m
CONFIG_MICROTRUST_TEE_SUPPORT=m
CONFIG_MTK_TEE_GP_SUPPORT=y
CONFIG_MTK_TEE_GP_COORDINATOR=m
CONFIG_TRUSTONIC_TEE_VERSION="500"
CONFIG_HAVE_MTK_ENABLE_GENIEZONE=y
CONFIG_MTK_ENABLE_GENIEZONE=m
CONFIG_MTK_GZ_MAIN=m
CONFIG_MTK_GZ_LOG=m
CONFIG_MTK_GZ_VIRTIO=m
CONFIG_MTK_GZ_VIRTIO_IPC=m
CONFIG_MTK_GZ_IRQ=m
CONFIG_MTK_GZ_TZ_SYSTEM=m
CONFIG_HAVE_MTK_GZ_LOG=y
CONFIG_MTK_MML_LEGACY=m
CONFIG_VIDEO_MEDIATEK_VCODEC=m
CONFIG_VIDEO_MEDIATEK_VCODEC_V1=y
CONFIG_VIDEO_MEDIATEK_VCU=m
CONFIG_VB2_MEDIATEK_DMA_CONTIG=m
CONFIG_VIDEO_MEDIATEK_VPU=m
CONFIG_MTK_MMDVFS=m
CONFIG_DRM_PANEL_HX83112B_AUO_CMD_RT5081=m
CONFIG_DRM_PANEL_TD4320_FHDP__AUO_VDO_RT5081=m
CONFIG_DRM_PANEL_SC_NT36672C_VDO_90HZ_6382=m
CONFIG_MTK_MT6382_BDG=m
CONFIG_SPI_MT65XX=m
CONFIG_MTK_PWM=m
CONFIG_OPLUS_FEATURE_SENSOR=y
CONFIG_OPLUS_FEATURE_SENSOR_ALGORITHM=y
CONFIG_SYLVIA_REPLACE_ORIGING=y
CONFIG_SYLVIA_REPLACE_ORIGING_ALGO=y
CONFIG_SYLVIA_FEATURE_SENSOR_TEST=m
CONFIG_OPLUS_SENSOR_FB_MTK=m
CONFIG_OPLUS_SENSOR_CMD=m
CONFIG_OPLUS_SENSOR_ATTR=m
CONFIG_OPLUS_SENSOR_EVENT=m
CONFIG_CUSTOM_KERNEL_GRV_SENSOR=y
CONFIG_CUSTOM_KERNEL_GMRV_SENSOR=y
CONFIG_CUSTOM_KERNEL_RV_SENSOR=y
CONFIG_CUSTOM_KERNEL_LINEARACCEL_SENSOR=y
CONFIG_CUSTOM_KERNEL_GRAVITY_SENSOR=y
CONFIG_CUSTOM_KERNEL_UNCALI_ACC_SENSOR=y
CONFIG_CUSTOM_KERNEL_UNCALI_GYRO_SENSOR=y
CONFIG_CUSTOM_KERNEL_UNCALI_MAG_SENSOR=y
CONFIG_CUSTOM_KERNEL_REAR_ALS=y
CONFIG_MTK_REAR_ALSHUB=y
CONFIG_CUSTOM_KERNEL_REAR_FLICKER=y
CONFIG_MTK_REAR_FLICKERHUB=y
CONFIG_MTK_SCHEDULER=m
CONFIG_MTK_OPP_CAP_INFO=y
CONFIG_NONLINEAR_FREQ_CTL=y
CONFIG_MTK_EAS=y
CONFIG_MTK_NEWIDLE_BALANCE=y
CONFIG_MTK_CORE_PAUSE=y
CONFIG_MTK_CORE_CTL=m
CONFIG_MTK_SCHED_BIG_TASK_ROTATE=y
CONFIG_MTK_CPUFREQ_SUGOV_EXT=m
CONFIG_MTK_IRTX_PWM_SUPPORT=m
CONFIG_KEYBOARD_MTK_KPD=m
CONFIG_KEYBOARD_MTK_PMIC=m
CONFIG_EXTCON_MTK_USB=m
CONFIG_MTK_MUSB_DRV_36BIT=y
CONFIG_MTK_MUSB_DUAL_ROLE=y
CONFIG_MTK_MUSB_QMU_SUPPORT=y
CONFIG_MTK_MUSB_QMU_PURE_ZLP_SUPPORT=y
CONFIG_MTK_USB_BOOST=m
CONFIG_MTK_USB_META=m
CONFIG_NOP_USB_XCEIV=m
CONFIG_PHY_MTK_TPHY=m
CONFIG_USB_MTK_HDRC=m
CONFIG_USB_MTK_OTG=y
#CONFIG_TCPC_MT6370=m
CONFIG_NVMEM=y
CONFIG_MTK_DEVINFO=m
CONFIG_MEDIATEK_MT6577_AUXADC=m
CONFIG_MEDIATEK_MT6370_ADC=m
CONFIG_MTK_SOCINFO=m
CONFIG_MTK_GPU_SUPPORT=m
CONFIG_MTK_GPU_MT6768_SUPPORT=m
CONFIG_MTK_GPUFREQ_V2=y
CONFIG_MTK_GPU_COMMON_DVFS_SUPPORT=y
CONFIG_EXT_MODULES="../vendor/mediatek/kernel_modules/gpu/platform/mt6768 ../vendor/mediatek/kernel_modules/connectivity/common ../vendor/mediatek/kernel_modules/connectivity/fmradio ../vendor/mediatek/kernel_modules/connectivity/common  ../vendor/mediatek/kernel_modules/connectivity/gps/gps_stp"
CONFIG_MTK_TINYSYS_SCP_SUPPORT=m
CONFIG_MTK_TINYSYS_SCP_CM4_SUPPORT=y
CONFIG_MTK_AMMS=m
CONFIG_SYSCON_REBOOT_MODE=m
CONFIG_RESET_TI_SYSCON=m
CONFIG_CUSTOM_KERNEL_IMGSENSOR="imx519_mipi_raw s5k2t7sp_mipi_raw s5k2p7_mipi_raw ov8856_mipi_raw imx386_mipi_raw imx398_mipi_raw s5k2l7_mipi_raw hi5022q_mipi_raw23618 sc820cs_mipi_raw23618 hi846_mipi_raw_oris ov50d40_mipi_raw_oris"
CONFIG_MTK_IMGSENSOR_ISP4=m
CONFIG_MTK_SENSOR_SUPPORT=m
CONFIG_MTK_SENSOR_ARCHITECTURE="1.0"
CONFIG_CUSTOM_KERNEL_ACCELEROMETER=y
CONFIG_MTK_ACCELHUB=y
CONFIG_CUSTOM_KERNEL_ALSPS=y
CONFIG_MTK_ALSPSHUB=y
CONFIG_CUSTOM_KERNEL_GYROSCOPE=y
CONFIG_MTK_GYROHUB=y
CONFIG_CUSTOM_KERNEL_MAGNETOMETER=y
CONFIG_MTK_MAGHUB=y
CONFIG_MTK_HWMON=y
CONFIG_CUSTOM_KERNEL_BAROMETER=y
CONFIG_MTK_BAROHUB=y
CONFIG_CUSTOM_KERNEL_STEP_COUNTER=y
CONFIG_MTK_STEPSIGNHUB=y
CONFIG_CUSTOM_KERNEL_SITUATION=y
CONFIG_MTK_STATHUB=y
CONFIG_MTK_WAKEHUB=y
CONFIG_MTK_GLGHUB=y
CONFIG_MTK_PICKUPHUB=y
CONFIG_MTK_DEVICE_ORIENTATION_HUB=y
CONFIG_MTK_MOTION_DETECT_HUB=y
CONFIG_MTK_TILTDETECTHUB=y
CONFIG_CUSTOM_KERNEL_SENSORHUB=y
CONFIG_NANOHUB=y
CONFIG_NANOHUB_MTK_IPI=y
CONFIG_CUSTOM_KERNEL_SENSOR_FUSION=y
CONFIG_MTK_ROTATVECHUB=y
CONFIG_MTK_GAMEROTVECHUB=y
CONFIG_MTK_GMAGROTVECHUB=y
CONFIG_MTK_GRAVITYHUB=y
CONFIG_MTK_LINEARACCHUB=y
CONFIG_MTK_ORIENTHUB=y
CONFIG_MTK_UNCALI_ACCHUB=y
CONFIG_MTK_UNCALI_GYROHUB=y
CONFIG_MTK_UNCALI_MAGHUB=y
CONFIG_MTK_MET=m
CONFIG_MTK_PPM_V3=m
CONFIG_MTK_QOS_MT6768=y
CONFIG_MTK_QOS_FRAMEWORK=m
#CONFIG_MTK_THERMAL=y
#CONFIG_MTK_SOC_THERMAL=m
#CONFIG_GENERIC_ADC_THERMAL=m
#CONFIG_MTK_PMIC_THERMAL=m
# CONFIG_MTK_MD_THERMAL=m
#CONFIG_MTK_CHARGER_THERMAL=m
#CONFIG_MTK_BACKLIGHT_THERMAL=m
CONFIG_MTK_LEGACY_THERMAL=m
CONFIG_MTK_LEGACY_PLATFORM="mt6768"
CONFIG_MTK_THERMAL_PA_VIA_ATCMD=y
CONFIG_SND_SOC_MT6358_ACCDET=m
CONFIG_MTK_TRUSTED_MEMORY_SUBSYSTEM=m
CONFIG_CFG80211=m
CONFIG_NL80211_TESTMODE=y
CONFIG_MAC80211=m
CONFIG_MTK_PERFORMANCE_MODULE=m
CONFIG_MTK_PERF_COMMON=m
CONFIG_MTK_PERF_TRACKER=y
CONFIG_MTK_TASK_TURBO=n
CONFIG_MTK_LOAD_TRACKER=m
CONFIG_MTK_FPSGO_V3=m
#CONFIG_ZSMALLOC=m
#CONFIG_ZRAM=m
CONFIG_MTK_TINYSYS_SCP_LOGGER_SUPPORT=y
CONFIG_KRETPROBES=y
CONFIG_KALLSYMS_ALL=y
CONFIG_KALLSYMS=y
CONFIG_KPROBES=y
CONFIG_MTK_PRINTK_UART_CONSOLE=y
CONFIG_MTK_PRINTK=m
CONFIG_DEVAPC_MT6768=m
CONFIG_COMMON_CLK_MTK_FREQ_HOPPING=m
CONFIG_COMMON_CLK_MTK_FREQ_HOPPING_SSPM=y
CONFIG_MTK_WIDEVINE_DRM=m
CONFIG_MTK_FB_MMDVFS_SUPPORT=y
CONFIG_MTK_CAM_TIMESYNC=m
CONFIG_MTK_CAMERA_MEM_SUPPORT=m
CONFIG_MTK_CAMERA_ISP_RAW_SUPPORT=m
CONFIG_MTK_CAMERA_ISP_SUPPORT=m
CONFIG_MTK_CAMERA_FD_VERSION40=m
CONFIG_MTK_CAMERA_DPE_ISP40=m
CONFIG_MTK_CAM_CAL=m
CONFIG_MTK_LENS=m
CONFIG_MTK_V4L2_LENS=m
CONFIG_MTK_CCCI_DEVICES=y
CONFIG_MTK_MD1_SUPPORT=25
CONFIG_MTK_ECCCI_DRIVER=m

#------start oplus add------#
#ifdef OPLUS_FEATURE_SECURITY_COMMON

#ifdef OPLUS_FEATURE_UFF_FINGERPRINT
CONFIG_UFF_FINGERPRINT=m
CONFIG_UFF_FINGERPRINT_MTK=y
CONFIG_OPLUS_FINGERPRINT_GKI_ENABLE=y
#endif /* OPLUS_FEATURE_UFF_FINGERPRINT */

#add for oplus secure
CONFIG_OPLUS_SECURE=y
CONFIG_OPLUS_SECURE_QCOM=n
CONFIG_OPLUS_SECURE_MTK=y
CONFIG_OPLUS_SECURE_COMMON=m
CONFIG_MTK_SMI_BWC=m
CONFIG_RPMB=m
#endif /* OPLUS_FEATURE_SECURITY_COMMON */

CONFIG_OPLUS_ION_BOOSTPOOL=y

#ifdef OPLUS_FEATURE_WIFI_CAPCENTER
CONFIG_OPLUS_FEATURE_WIFI_CAPCENTER=m
#endif /* OPLUS_FEATURE_WIFI_CAPCENTER */
CONFIG_OPLUS_COMMON_SOFT=y
CONFIG_OPLUS_DEVICE_IFNO=m
#ifdef OPLUS_BUG_STABILITY
CONFIG_OPLUS_SYSTEM_KERNEL=y
CONFIG_OPLUS_FEATURE_FDLEAK_CHECK=m
CONFIG_OPLUS_FEATURE_KMSG_WB=m
#ifdef OPLUS_FEATURE_UIFIRST
CONFIG_SCHED_WALT=y
#endif /* OPLUS_FEATURE_UIFIRST */
CONFIG_OPLUS_HANS=y
#endif /* OPLUS_BUG_STABILITY */

#ifdef OPLUS_FEATURE_SENSOR_ALGORITHM
CONFIG_OPLUS_FEATURE_CAMERA_PROTECT=y
CONFIG_OPLUS_FEATURE_FREE_FALL=y
CONFIG_OPLUS_FEATURE_PICKUP_DETECT=y
CONFIG_OPLUS_FEATURE_LAY_DETECT=y
CONFIG_OPLUS_FEATURE_PALM_DETECT=y
CONFIG_OPLUS_FEATURE_FP_DISPLAY=y
CONFIG_OPLUS_FEATURE_LUX_AOD=y
CONFIG_OPLUS_FEATURE_PEDO_MINUTE=y
CONFIG_OPLUS_FEATURE_ACTIVITY_RECOGNITION=y
CONFIG_OPLUS_FEATURE_TP_GESTURE=y
CONFIG_OPLUS_FEATURE_ELEVATOR_DETECT=y
CONFIG_OPLUS_FEATURE_ROTATION_DETECT=y
CONFIG_OPLUS_FEATURE_BACK_TAP_DETECT=y
CONFIG_OPLUS_FEATURE_PHONE_PROX=y
CONFIG_OPLUS_FEATURE_GESTURE_PROX=y
CONFIG_OPLUS_FEATURE_AMBIENTE_PROX=y
#endif /*OPLUS_FEATURE_SENSOR_ALGORITHM*/

#ifdef OPLUS_FEATURE_ACTIVITY_RECOGNITION
CONFIG_OPLUS_FEATURE_ACTIVITY_RECOGNITION=y
#endif //OPLUS_FEATURE_ACTIVITY_RECOGNITION
#ifdef OPLUS_FEATURE_ELEVATOR_DETECT
CONFIG_OPLUS_FEATURE_ELEVATOR_DETECT=y
#endif //OPLUS_FEATURE_ELEVATOR_DETECT
#ifdef OPLUS_FEATURE_PROCESS_RECLAIM
CONFIG_PROCESS_RECLAIM=y
#endif
#ifdef OPLUS_FEATURE_PHOENIX
CONFIG_OPLUS_FEATURE_PHOENIX=m
#endif
#ifdef OPLUS_FEATURE_EXFAT_SUPPORT
CONFIG_EXFAT_FS=y
CONFIG_NTFS_FS=y
CONFIG_NTFS_RW=y
#endif /* OPLUS_FEATURE_EXFAT_SUPPORT */
#Move all oplus feature to here,TODO ...
CONFIG_DETECT_HUNG_TASK=y
CONFIG_OPLUS_FEATURE_HUNG_TASK_ENHANCE=m
CONFIG_DEFAULT_HUNG_TASK_TIMEOUT=60

#ifdef OPLUS_FEATURE_UIFIRST
CONFIG_KERNEL_LOCK_OPT=y
CONFIG_OPLUS_UX_IM_FLAG=y
CONFIG_OPLUS_FEATURE_AUDIO_OPT=y
#endif /* OPLUS_FEATURE_UIFIRST */
#ifdef OPLUS_FEATURE_ZRAM_OPT
CONFIG_OPLUS_ZRAM_OPT=y
CONFIG_CRYPTO_LZ4=y
CONFIG_PGTABLE_MAPPING=y
#endif /* OPLUS_FEATURE_ZRAM_OPT */
CONFIG_CRYPTO_ZSTD=y

CONFIG_OPLUS_ALLBOOST_OPT=y

#ifdef OPLUS_FEATURE_MM
# CONFIG_BALANCE_ANON_FILE_RECLAIM=y is not set
#endif

CONFIG_OPLUS_FEATURE_KTV_V2_NONDAPM=y
CONFIG_EXT4_FSYNC=y

CONFIG_EXT4_ASYNC_DISCARD_SUPPORT=y
#endif
#ifdef OPLUS_FEATURE_IOMONITOR
# CONFIG_IOMONITOR=y is not set
# CONFIG_IOMONITOR_WITH_F2FS=n  is not set
#endif /*OPLUS_FEATURE_IOMONITOR*/

#ifdef OPLUS_FEATURE_WIFI_SLA
#todo: need to change to m when GKI
CONFIG_OPLUS_FEATURE_WIFI_SLA=m
#endif /* OPLUS_FEATURE_WIFI_SLA */

#ifdef OPLUS_FEATURE_DATA_EVAL
CONFIG_OPLUS_FEATURE_DATA_EVAL=m
#endif /*OPLUS_FEATURE_DATA_EVAL*/

#ifdef OPLUS_FEATURE_HEALTHINFO
# CONFIG_OPLUS_JANK_INFO=y is not set
#endif /* OPLUS_FEATURE_HEALTHINFO */
#ifdef OPLUS_FEATURE_HEALTHINFO
CONFIG_OPLUS_MEM_MONITOR=y
CONFIG_FG_TASK_UID=y
CONFIG_OPLUS_HEALTHINFO=y
CONFIG_SCHEDSTATS=y
#endif /*OPLUS_FEATURE_HEALTHINFO*/
CONFIG_OPLUS_FEATURE_SHUTDOWN_DETECT=y
CONFIG_OPLUS_FEATURE_PROJECTINFO=m
CONFIG_OPLUS_FEATURE_BOOTARGS=m
CONFIG_OPLUS_FEATURE_INIT_WATCHDOG=m
CONFIG_OPLUS_FEATURE_KEYEVENT_HANDLER=m
CONFIG_OPLUS_FEATURE_COMBKEY_MONITOR=m
CONFIG_OPLUS_FEATURE_HANS_GKI=m
CONFIG_OPLUS_BSP_DFR_USERSPACE_BACKTRACE=m
CONFIG_OPLUS_FEATURE_SAUPWK=m
CONFIG_OPLUS_FEATURE_LAST_BOOT_REASON=m

CONFIG_MEMLEAK_DETECT=m
CONFIG_THP_ZSMALLOC=m
CONFIG_OPLUS_FEATURE_MM_OSVELTE=m
CONFIG_CRYPTO_ZSTDN=m
CONFIG_HYBRIDSWAP_ZRAM=m
CONFIG_KSHRINK_SLABD=m
CONFIG_PCPPAGES_OPT=m
CONFIG_MAPPED_PROTECT=m
CONFIG_MAPPED_PROTECT_ALL=y
CONFIG_KSHRINK_LRUVECD=m
CONFIG_HORAE_THERMAL_SHELL=m

#ifdef OPLUS_FEATURE_FEEDBACK
CONFIG_OPLUS_FEATURE_FEEDBACK=m
#endif /*OPLUS_FEATURE_FEEDBACK*/

#ifdef OPLUS_FEATURE_FG_IO_OPT
CONFIG_OPLUS_FG_IO_OPT=y
#endif

CONFIG_INPUT_JOYSTICK=y
CONFIG_JOYSTICK_XPAD=y
CONFIG_JOYSTICK_XPAD_FF=y
CONFIG_JOYSTICK_XPAD_LEDS=y

#ifdef OPLUS_FEATURE_MEMLEAK_DETECT
CONFIG_KMALLOC_DEBUG=y
CONFIG_VMALLOC_DEBUG=y
CONFIG_DUMP_TASKS_MEM=m
#endif

#ifdef OPLUS_FEATURE_WIFI_ROUTERBOOST
CONFIG_NETFILTER_XT_TARGET_DSCP=y
CONFIG_NETFILTER_XT_MATCH_DSCP=y
#endif /* OPLUS_FEATURE_WIFI_ROUTERBOOST */

#ifdef OPLUS_FEATURE_ACM
CONFIG_OPLUS_FEATURE_ACM=y
CONFIG_OPLUS_FEATURE_ACM_LOGGING=y
#endif /* OPLUS_FEATURE_ACM */

CONFIG_OPLUS_FEATURE_PMIC_MONITOR_MTK=m

#ifdef OPLUS_MTK_USERIMAGES_USE_F2FS
CONFIG_F2FS_FS=y
CONFIG_F2FS_FS_SECURITY=y
CONFIG_F2FS_FS_COMPRESSION=y
CONFIG_F2FS_FS_LZ4=y
CONFIG_F2FS_FS_COMPRESSION_FIXED_OUTPUT=y
#endif /* OPLUS_MTK_USERIMAGES_USE_F2FS */
CONFIG_LOG_BUF_SHIFT=20
CONFIG_OPLUS_FEATURE_EXT4_FSYNC=y

CONFIG_OPLUS_FEATURE_OF2FS=y
CONFIG_EROFS_FS=y
#ifdef OPLUS_FEATURE_SENSOR
CONFIG_OPLUS_ALS_CALI=y
#endif


CONFIG_SIA_PA_ALGO=y
CONFIG_SND_SOC_AW87XXX_2_X_0=y
CONFIG_SND_SOC_OPLUS_PA_MANAGER=m
CONFIG_OPLUS_FEATURE_MM_FEEDBACK=m
CONFIG_HSKEY_BLOCK=y

#ifdef OPLUS_FEATURE_NFC_BRINGUP
CONFIG_OPLUS_NFC=m
CONFIG_NFC_PN553_DEVICES=m
#endif /*OPLUS_FEATURE_NFC_BRINGUP*/

# BSP.Kernel.Performance, 2022/10/25, add for memory lock optimization in kernel
CONFIG_LOOK_AROUND=m
CONFIG_OPLUS_FG_PROTECT=y
CONFIG_SHRINK_LRU_TRYLOCK=y
CONFIG_LOCKING_PROTECT=y

#ifdef OPLUS_FEATURE_HYBRIDSWAP
CONFIG_HYBRIDSWAP=y
CONFIG_HYBRIDSWAP_SWAPD=y
CONFIG_HYBRIDSWAP_CORE=y
#endif

# nfc bringup
CONFIG_TMS_NFC_DEVICE=m
CONFIG_TMS_ESE_DEVICE=n

#ifdef OPLUS_FEATURE_MULTI_KSWAPD
#/*.Kernel.MM, 2022-04-07,add multi kswapd support*/
CONFIG_OPLUS_MULTI_KSWAPD=y
#endif /*OPLUS_FEATURE_MULTI_KSWAPD*/
CONFIG_SIM_DETECT=m
#ifdef OPLUS_FEATURE_KEY_SECURITY
CONFIG_MTK_DRM_KEY_MNG_SUPPORT=y
CONFIG_MTK_SEC_VIDEO_PATH_SUPPORT=y
#CONFIG_MTK_SVP_ON_MTEE_SUPPORT=y
#endif /* OPLUS_FEATURE_KEY_SECURITY */
CONFIG_KPD_PMIC_LPRST_TD=1
CONFIG_MTK_AEE_UT=y

#ifdef OPLUS_FEATURE_STATS_CALC
CONFIG_OPLUS_FEATURE_STATS_CALC=m
#endif /* OPLUS_FEATURE_STATS_CALC */

#ifdef OPLUS_FEATURE_OLC
CONFIG_OPLUS_FEATURE_OLC=m
#endif /* OPLUS_FEATURE_OLC */

CONFIG_OPLUS_CHARGER_MTK_CHGIC=y
CONFIG_OPLUS_CHARGER=y
CONFIG_OPLUS_CHARGER_MTK=y
CONFIG_OPLUS_CHARGER_MTK6769U=y
CONFIG_OPLUS_HVDCP_SUPPORT=y
CONFIG_OPLUS_SHIP_MODE_SUPPORT=y
CONFIG_OPLUS_SMART_CHARGER_SUPPORT=y
CONFIG_OPLUS_4400MV_BATTERY_SUPPORT=y
CONFIG_OPLUS_CALL_MODE_SUPPORT=y
CONFIG_OPLUS_CHECK_CHARGERID_VOLT=y
CONFIG_OPLUS_CHIP_SOC_NODE=y

#CHG_TEST
CONFIG_OPLUS_CHG_TEST_KIT=m
CONFIG_OPLUS_MTK_DRM_GKI_NOTIFY_CHG=y

CONFIG_OPLUS_ROOT_CHECK=y
CONFIG_OPLUS_EXECVE_BLOCK=y
CONFIG_OPLUS_MOUNT_BLOCK=y
CONFIG_OPLUS_SECURE_GUARD=y
CONFIG_OPLUS_FEATURE_THEIA=m

#ifdef OPLUS_FEATURE_GAME_OPT
CONFIG_OPLUS_FEATURE_GAME_OPT=y
#endif
CONFIG_OPLUS_UXMEM_OPT=y
CONFIG_OPLUS_DYNAMIC_READAHEAD=y

CONFIG_OPLUS_BLK_MONITOR=y

CONFIG_OPLUS_FEATURE_BACK_TAP_DETECT=y

CONFIG_OPLUS_FEATURE_PALM_DETECT=y

#display bias
CONFIG_MTK_GATE_IC=y
CONFIG_OCP2130_I2C=m


CONFIG_TOUCHPANEL_MTK_PLATFORM=y
CONFIG_OPLUS_FEATURE_DEATH_HEALER=m

#ifdef OPLUS_FEATURE_PERFORMANCE_SCHED
CONFIG_OPLUS_FEATURE_PERFORMANCE_SCHED=y
CONFIG_OPLUS_FEATURE_SCHED_ASSIST=m
CONFIG_OPLUS_FEATURE_TASK_SCHED=m
CONFIG_OPLUS_FEATURE_BAN_APP_SET_AFFINITY=m
CONFIG_OPLUS_BINDER_PRIO_SKIP=y
#endif /* OPLUS_FEATURE_PERFORMANCE_SCHED */
CONFIG_OPLUS_FEATURE_CPU_JANKINFO=m
CONFIG_OPLUS_BINDER_STRATEGY=m
CONFIG_OPLUS_LOCKING_STRATEGY=m
CONFIG_OPLUS_LOCKING_OSQ=y
CONFIG_OPLUS_LOCKING_MONITOR=y
CONFIG_OPLUS_CPU_AUDIO_PERF=y
CONFIG_OPLUS_FEATURE_VT_CAP=m
CONFIG_OPLUS_FEATURE_EAS_OPT=m
CONFIG_OPLUS_CPUFREQ_IOWAIT_PROTECT=m
#CONFIG_OPLUS_FEATURE_LOADBALANCE is not set
CONFIG_OPLUS_FEATURE_PIPELINE=y

#ifdef OPLUS_FEATURE_PERFORMANCE_FS
CONFIG_OPLUS_FEATURE_PERFORMANCE_FS=y
#endif /* OPLUS_FEATURE_PERFORMANCE_FS */

#ifdef OPLUS_FEATURE_PERFORMANCE_MM
CONFIG_OPLUS_FEATURE_PERFORMANCE_MM=y
CONFIG_OPLUS_FEATURE_MM_BOOSTPOOL=m
CONFIG_OPLUS_FEATURE_ZRAM_OPT=m
CONFIG_PROACTIVE_COMPACT=m
CONFIG_OPLUS_MTK_OOM_REAPER=y
CONFIG_OPLUS_FEATURE_UXMEM_OPT=m
CONFIG_OPLUS_FEATURE_DYNAMIC_READAHEAD=m
CONFIG_OPLUS_FEATURE_SIGKILL_DIAGNOSIS=m
CONFIG_OPLUS_FEATURE_KSWAPD_OPT=m
#endif /* OPLUS_FEATURE_PERFORMANCE_MM */
#ifdef OPLUS_BUG_STABILITY
CONFIG_OPLUS_FEATURE_CMDLINE=m
CONFIG_OPLUS_FEATURE_OPLUSBOOT=m
CONFIG_OPLUS_FEATURE_BUILDVARIANT=m
CONFIG_OPLUS_FEATURE_OPROJECT=m
CONFIG_SECTION_MISMATCH_WARN_ONLY=y
CONFIG_MTK_BOOT_COMMON=m
CONFIG_OPLUS_FEATURE_MTK_FORCE_SHUTDOWN=m
CONFIG_OPLUS_FEATURE_SHUTDOWN_DETECT=m
#endif /* OPLUS_BUG_STABILITY */

##################start add diff for mgk_64_k510_defconfig############
#ifdef OPLUS_FEATURE_MM_OSVELTE
CONFIG_OPLUS_FEATURE_MM_OSVELTE=m
#endif /* OPLUS_FEATURE_MM_OSVELTE */

#ifdef OPLUS_FEATURE_TP_BASIC
CONFIG_OPLUS_MTK_DRM_GKI_NOTIFY=y
CONFIG_OPLUS_MTK_DRM_SUB_NOTIFY=y
CONFIG_TOUCHPANEL_OPLUS=m
CONFIG_TOUCHPANEL_NOTIFY=m
CONFIG_TOUCHPANEL_CUSTOM=m
CONFIG_TOUCHPANEL_ILITEK=m
CONFIG_TOUCHPANEL_ILITEK_ILITEK9882N=m
CONFIG_TOUCHPANEL_ILITEK_ILITEK7807S=m
CONFIG_TOUCHPANEL_SYNAPTICS=m
CONFIG_TOUCHPANEL_SYNAPTICS_TD4377_NOFLASH=m
CONFIG_OPLUS_FW_UPDATE=m

CONFIG_SND_USB_AUDIO_USE_MEDIA_CONTROLLER=y
CONFIG_SND_USB_AUDIO=y
CONFIG_SND_USB=y
CONFIG_SND_SOC_FSA=m
CONFIG_MTK_USB_TYPEC=m
CONFIG_MTK_USB_TYPEC_MUX=m
CONFIG_TYPEC_MUX_ALPHA_FSA4480=m
CONFIG_TYPEC=y
CONFIG_SND_SOC_SIA81XX=m
CONFIG_DRM_PANEL_OPLUS23703_ILI9883C_DJ_HDP_DSI_VDO=m
CONFIG_DRM_PANEL_OPLUS23703_ILI9883C_HKC_HDP_DSI_VDO=m
CONFIG_DRM_PANEL_OPLUS24700_ILI7807S_TM_FHDP_DSI_VDO=m
CONFIG_DRM_PANEL_OPLUS24700_TD4377_CSOT_FHDP_DSI_VDO=m
CONFIG_DRM_PANEL_OPLUS24700_TD4376B_CSOT_FHDP_DSI_VDO=m

CONFIG_OPLUS_FEATURE_FRAME_BOOST=m
CONFIG_UA_KERNEL_CPU_IOCTL=m
CONFIG_OPLUS_FEATURE_TASK_CPUSTATS=m
CONFIG_OPLUS_FEATURE_GKI_CPUFREQ_BOUNCING=m
CONFIG_OPLUS_OMRG=m

#------end oplus add------#
CONFIG_MTK_ECCCI_C2K_USB=m
CONFIG_MTK_CCU=m
CONFIG_MTK_FLASHLIGHT=m
CONFIG_MTK_FLASHLIGHT_PT=y
CONFIG_MTK_FLASHLIGHT_PT_STRICT=y
CONFIG_MTK_V4L2_FLASHLIGHT=m
CONFIG_V4L2_FLASH_LED_CLASS=m
CONFIG_MTK_VIDEO_SC6607_24700=m
CONFIG_USB_NET_AX8817X=m
CONFIG_ARM_DSU_PMU=m
CONFIG_MTK_USB_CONFIGFS_RNDIS=m
CONFIG_USB_NET_AX88179_178A=m
CONFIG_UNISOC_IOLIMIT=m
```
